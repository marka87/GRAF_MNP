/*
* display.c
*
*  Created on: Nov 27, 2024
*      Author: AnMa
*/

//#include <asf.h>
#include "display.h"
#include <string.h>
#include <stdarg.h>
#include <stdio.h>
char display_buffer[DISPLAY_MAX_LINES][30] = { { 0 } };



// Display Commands (ST7567) //Instruction Table DB 21/49
#define DISPLAY_JAZZ_CMD_DISPLAY_ON_OFF				(0xAE)
#define DISPLAY_ON							(0x01)
#define DISPLAY_JAZZ_CMD_SET_START_LINE				(0x40)
#define DISPLAY_JAZZ_CMD_SET_PAGE_ADDRESS			(0xB0)
#define DISPLAY_JAZZ_CMD_SET_COLUMN_ADDRESS_MSB		(0x10)
#define DISPLAY_JAZZ_CMD_SET_COLUMN_ADDRESS_LSB		(0x00)
#define DISPLAY_JAZZ_CMD_SEG_DIRECTION				(0xA0)
#define SEG_DIRECTION_NORMAL				(0x00)
#define SEG_DIRECTION_REVERSE				(0x01)
#define DISPLAY_JAZZ_CMD_INVERSE_DISPLAY				(0xA6)
#define INVERSE_DISPLAY_NORMAL				(0x00)
#define INVERSE_DISPLAY_INVERSE				(0x01)
#define DISPLAY_JAZZ_CMD_ALL_PIXEL_ON				(0xA4)
#define ALL_PIXEL_ON_NORMAL					(0x00)
#define ALL_PIXEL_ON_ALL_PIXEL_ON			(0x01)
#define DISPLAY_JAZZ_CMD_BIAS_SELECT					(0xA2)
#define BIAS_SELECT_1_9						(0x00)
#define BIAS_SELECT_1_7						(0x01)
#define DISPLAY_JAZZ_CMD_END							(0xEE)
#define DISPLAY_JAZZ_CMD_RESET						(0xE2)
#define DISPLAY_JAZZ_CMD_COM_DIRECTION				(0xC0)
#define COM_DIRECTION_NORMAL				(0x00)
#define COM_DIRECTION_REVERSE				(0x08)
#define DISPLAY_JAZZ_CMD_POWER_CONTROL				(0x28)
#define BUILT_IN_BOOSTER_ON					(0x04)
#define BUILT_IN_REGULATOR_ON				(0x02)
#define BUILT_IN_FOLLOWER_ON				(0x01)
#define DISPLAY_JAZZ_CMD_REGULATION_RATIO			(0x20)
#define REGULATION_RATIO_RR0				(0x01)
#define REGULATION_RATIO_RR1				(0x02)
#define REGULATION_RATIO_RR2				(0x04)
#define DISPLAY_JAZZ_CMD_SET_EV						(0x81)
#define EV_EV0								(0x01)
#define EV_EV1								(0x02)
#define EV_EV2								(0x04)
#define EV_EV3								(0x08)
#define EV_EV4								(0x10)
#define EV_EV5								(0x20)
#define DISPLAY_JAZZ_CMD_SET_BOOSTER					(0xF8)
#define BOOSTER_LEVEL_4X					(0x00)
#define BOOSTER_LEVEL_5X					(0x01)
#define DISPLAY_JAZZ_CMD_NOP							(0xE3)

// The default font
const uint8_t font5x7[128][6] =
{
	{0x00,0x00,0x00,0x00,0x00,0x00},	// NULL
	{0x00,0x00,0x00,0x00,0x00,0x00},	// Start of header
	{0x00,0x00,0x00,0x00,0x00,0x00},	// Start of Text
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	{0x00,0x00,0x06,0x09,0x09,0x06}		// Degree
};
// umschreiben wegen NSS, vielleicht hier funktioniert. Display SPI2
void display_jazz_write_command(display_info_t* disp, uint8_t cmd) //send a command
{
	HAL_GPIO_WritePin(GPIOB, DISP_A0_Pin, GPIO_PIN_RESET);
//	HAL_GPIO_WritePin(SPI1_NSS_GPIO_Port, SPI1_NSS_Pin, GPIO_PIN_RESET);
//	HAL_SPI_Transmit(disp->spi_handle, &cmd, 1, 2000);
//	HAL_GPIO_WritePin(SPI1_NSS_GPIO_Port, SPI1_NSS_Pin, GPIO_PIN_SET);

	HAL_SPI_Transmit(disp->spi_handle, &cmd, 1, 2000);
	HAL_GPIO_WritePin(GPIOB, DISP_A0_Pin, GPIO_PIN_SET);
}
void display_jazz_write_data(display_info_t* disp, uint8_t data)	//send a data
{
	HAL_GPIO_WritePin(GPIOB, DISP_A0_Pin, GPIO_PIN_SET);
//	HAL_GPIO_WritePin(SPI1_NSS_GPIO_Port, SPI1_NSS_Pin, GPIO_PIN_RESET);
//	HAL_SPI_Transmit(disp->spi_handle, &data, 1, 2000);
//	HAL_GPIO_WritePin(SPI1_NSS_GPIO_Port, SPI1_NSS_Pin, GPIO_PIN_SET);

	HAL_SPI_Transmit(disp->spi_handle, &data, 1, 2000);
	HAL_GPIO_WritePin(GPIOB, DISP_A0_Pin, GPIO_PIN_SET);
}

void display_jazz_reset(display_info_t* disp)	//reset the display - Reset pin L -> wait- H - wait
{
		HAL_GPIO_WritePin(RST_DISPLAY_GPIO_Port, RST_DISPLAY_Pin, GPIO_PIN_RESET);
		HAL_Delay(1);
		HAL_GPIO_WritePin(RST_DISPLAY_GPIO_Port, RST_DISPLAY_Pin, GPIO_PIN_SET);
		HAL_Delay(5);
}

void display_jazz_init(display_info_t* disp)	//display init from ZuMa
{
	display_jazz_reset(disp);

	display_jazz_write_command(disp, DISPLAY_JAZZ_CMD_SET_START_LINE);
	display_jazz_write_command(disp, DISPLAY_JAZZ_CMD_BIAS_SELECT | BIAS_SELECT_1_9);
	display_jazz_write_command(disp, DISPLAY_JAZZ_CMD_SEG_DIRECTION | SEG_DIRECTION_REVERSE);
	display_jazz_write_command(disp, DISPLAY_JAZZ_CMD_INVERSE_DISPLAY | INVERSE_DISPLAY_NORMAL);
	display_jazz_write_command(disp, DISPLAY_JAZZ_CMD_COM_DIRECTION | COM_DIRECTION_REVERSE);
	display_jazz_write_command(disp, DISPLAY_JAZZ_CMD_REGULATION_RATIO | REGULATION_RATIO_RR0 | REGULATION_RATIO_RR1 | REGULATION_RATIO_RR2);
	display_jazz_write_command(disp, DISPLAY_JAZZ_CMD_SET_EV);
	display_jazz_write_command(disp, EV_EV3);
	display_jazz_write_command(disp, DISPLAY_JAZZ_CMD_SET_BOOSTER);
	display_jazz_write_command(disp, BOOSTER_LEVEL_5X);
	display_jazz_write_command(disp, DISPLAY_JAZZ_CMD_POWER_CONTROL | BUILT_IN_BOOSTER_ON | BUILT_IN_REGULATOR_ON | BUILT_IN_FOLLOWER_ON);
	display_jazz_write_command(disp, DISPLAY_JAZZ_CMD_DISPLAY_ON_OFF | DISPLAY_ON);
	display_jazz_clear(disp);

}

void display_jazz_fillpattern(display_info_t* disp, uint8_t pattern) {
	for (uint32_t page = 0; page < disp->lcd_ram_pages; page++) {

		display_jazz_position(disp, page, 0);	// column increments automatically

		for(uint32_t column = 0; column < disp->lcd_width; column++) {

			display_jazz_write_data(disp, pattern);
		}
	}
}

void display_jazz_position(display_info_t* disp, uint8_t page, uint8_t column) {
	uint8_t column_offset = 4;		// set column_offset to zero, if SEG Direction is normal and COM Direction is normal
	display_jazz_write_command(disp, DISPLAY_JAZZ_CMD_SET_PAGE_ADDRESS | (page & 0x0F));			// page address
	display_jazz_write_command(disp, DISPLAY_JAZZ_CMD_SET_COLUMN_ADDRESS_MSB | (((column+column_offset)>>4) & 0x0F));		// MSB column address
	display_jazz_write_command(disp, DISPLAY_JAZZ_CMD_SET_COLUMN_ADDRESS_LSB | ((column+column_offset) & 0x0F));				// LSB column address
}

void display_jazz_write_string(display_info_t* disp, uint8_t row, const char * fmt, ...) {

	char text[256] = {0};

	va_list args;
	va_start(args, fmt);
	vsnprintf(text, 255, fmt, args);
	va_end(args);

	display_jazz_write_string_5x7(disp, row, text);
}
void display_jazz_write_string_5x7(display_info_t* disp, uint32_t row, char *str) {
	uint32_t len = strlen(str);
	const int char_size = 6;

	uint32_t row_length_char = disp->lcd_width / char_size;

	// Check if the string matches the display area, otherwise reduce the string length
	if (len > row_length_char) {
		len = row_length_char;	// Reduce string to a useful size
	}

	display_jazz_position(disp, 0, 0);

	for (uint32_t i = 0; i < len; i++) {
		display_jazz_write_letter_5x7(disp, row, i * 6, str[i]);
	}

	// check if we need to add empty characters
	for (uint32_t i = len; i < row_length_char; i++) {
		display_jazz_write_letter_5x7(disp, row, i * 6, ' ');
	}
}
void display_jazz_write_letter_5x7(display_info_t* disp, uint8_t row, uint8_t column, char c) {

	display_jazz_position(disp, row, column);

	for (uint8_t i = 0; i < 6; i++)	{
		display_jazz_write_data(disp, font5x7[(uint8_t)c][i]);
	}

}

void display_jazz_clear(display_info_t* disp) {

	display_jazz_fillpattern(disp, 0x00);
}

void print_graph(display_info_t* disp, uint8_t data[], uint32_t size) {
	uint8_t page = 3;
	uint8_t column = 0;

	display_jazz_position(disp, 3, 0);

	for(uint32_t i = 0; i < size; i++) {
		display_jazz_write_data(disp, data[i]);
		column++;

		if(column >= disp->lcd_width) {	// end of column
			page++;
			column = 0;
			display_jazz_position(disp, page, column);	// jump to next page, start from column 0
		}
	}
}
